## conf/layer.conf
```bitbake
# We have a conf and classes directory, add to BBPATH
BBPATH .= ":${LAYERDIR}"

# We have recipes-* directories, add to BBFILES
BBFILES += "${LAYERDIR}/recipes-*/*/*.bb \
	${LAYERDIR}/recipes-*/*/*.bbappend"

BBFILE_COLLECTIONS += "updatehub-freescale"
BBFILE_PATTERN_updatehub-freescale = "^${LAYERDIR}/"
BBFILE_PRIORITY:updatehub-freescale = "6"

LAYERSERIES_COMPAT_updatehub-freescale = "styhead"
LAYERDEPENDS:updatehub-freescale = "updatehub"


###
# Global setting to use UpadateHub with meta-freescale layer
#
# Setting to use wic image
IMAGE_BOOT_FILES:updatehub-imx ??= ""
WKS_FILE_DEPENDS:append:updatehub-imx = " virtual/bootloader"
IMAGE_FSTYPES:updatehub-imx ??= "tar.xz wic.bmap wic.gz"
WKS_SEARCH_PATH:updatehub-imx ??= "${THISDIR}:${@':'.join('%s/wic' % p for p in '${BBPATH}'.split(':'))}:${@':'.join('%s/scripts/lib/wic/canned-wks' % l for l in '${BBPATH}:${COREBASE}'.split(':'))}"

# UpdateHub settings
UPDATEHUB_ACTIVE_INACTIVE_BACKEND:updatehub-imx ??= "u-boot"
UPDATEHUB_DEVICE_IDENTITY:updatehub-imx ??= "primary-iface"
UPDATEHUB_FILESYSTEM_SUPPORT:updatehub-imx ??= "ext4"
UPDATEHUB_IMAGE_TYPE:updatehub-imx ??= "active/inactive"
UPDATEHUB_INSTALL_MODE:updatehub-imx ??= "tarball"

PREFERRED_RPROVIDER_u-boot-fw-utils:updatehub-imx ??= "libubootenv"
PREFERRED_PROVIDER_u-boot-default-script:updatehub-imx ??= "u-boot-updatehub-script"
UPDATEHUB_RUNTIME_PACKAGES:append:updatehub-imx = " u-boot-default-script u-boot-default-env"
MACHINE_ESSENTIAL_EXTRA_RDEPENDS:updatehub-imx += " \
    kernel-image \
    kernel-devicetree \
"

# Do not change fstab file
WIC_CREATE_EXTRA_ARGS:updatehub-imx ??= "--no-fstab-update"

###
# Configuration for i.MX6 SABRE AUTO and SABRE Smart Device
#
# UpdateHub settings for imx6qdlsabresd machine
MACHINEOVERRIDES:prepend:imx6qdlsabresd = "updatehub-imx:"
WKS_FILES:updatehub-imx:imx6qdlsabresd ??= "updatehub.imx-uboot-spl-bootpart.wks.in"
IMAGE_BOOT_FILES:updatehub-imx:imx6qdlsabresd ??= "boot.scr-${MACHINE};boot.scr"
# UpdateHub Bootscript variables for imx6qdlsabresd machine
UPDATEHUB_BOOTSCRIPT_LOAD_A:updatehub-imx:imx6qdlsabresd ??= "\
load mmc \${mmcdev}:2 \${loadaddr} /boot/\${image}; run findfdt; run video_args_script; \
load mmc \${mmcdev}:2 \${fdt_addr} /boot/\${fdtfile}; \
"
UPDATEHUB_BOOTSCRIPT_LOAD_B:updatehub-imx:imx6qdlsabresd ??= "\
load mmc \${mmcdev}:3 \${loadaddr} /boot/\${image}; run findfdt; run video_args_script; \
load mmc \${mmcdev}:3 \${fdt_addr} /boot/\${fdtfile}; \
"
UPDATEHUB_BOOTSCRIPT_FIND_ROOT_A:updatehub-imx:imx6qdlsabresd ??= "part uuid mmc \${mmcdev}:2 uuid"
UPDATEHUB_BOOTSCRIPT_FIND_ROOT_B:updatehub-imx:imx6qdlsabresd ??= "part uuid mmc \${mmcdev}:3 uuid"
UPDATEHUB_BOOTSCRIPT_BOOTARGS:updatehub-imx:imx6qdlsabresd ??= "\
root=PARTUUID=\${uuid} rootfstype=ext4 rootwait rw \
console=\${console},\${baudrate} \${video_args} \
"
UPDATEHUB_BOOTSCRIPT_BOOTCMD:updatehub-imx:imx6qdlsabresd ??= "bootz \${loadaddr} - \${fdt_addr}"



###
# Configuration for i.MX6 Wandboard Quad/Dual/Solo
#
# UpdateHub settings for wandboard machine
MACHINEOVERRIDES:prepend:wandboard = "updatehub-imx:"
WKS_FILES:updatehub-imx:wandboard ??= "updatehub.imx-uboot-spl-bootpart.wks.in"
IMAGE_BOOT_FILES:updatehub-imx:wandboard ??= "boot.scr-${MACHINE};boot.scr"
# UpdateHub Bootscript variables for wandboard machine
UPDATEHUB_BOOTSCRIPT_LOAD_A:updatehub-imx:wandboard ??= "\
load mmc \${devnum}:2 \${loadaddr} /boot/${KERNEL_IMAGETYPE}; run findfdt; \
load mmc \${devnum}:2 \${fdt_addr} /boot/\${fdtfile} \
"
UPDATEHUB_BOOTSCRIPT_LOAD_B:updatehub-imx:wandboard ??= "\
load mmc \${devnum}:3 \${loadaddr} /boot/${KERNEL_IMAGETYPE}; run findfdt; \
load mmc \${devnum}:3 \${fdt_addr} /boot/\${fdtfile} \
"
UPDATEHUB_BOOTSCRIPT_FIND_ROOT_A:updatehub-imx:wandboard ??= "part uuid mmc \${devnum}:2 uuid"
UPDATEHUB_BOOTSCRIPT_FIND_ROOT_B:updatehub-imx:wandboard ??= "part uuid mmc \${devnum}:3 uuid"
UPDATEHUB_BOOTSCRIPT_BOOTARGS:updatehub-imx:wandboard ??= "\
console=\${console},\${baudrate} root=PARTUUID=\${uuid} rootwait rw \${video_args} \
"
UPDATEHUB_BOOTSCRIPT_BOOTCMD:updatehub-imx:wandboard ??= "bootz \${loadaddr} - \${fdt_addr}"



###
# Configuration for Boundary Devices
#
# UpdateHub settings for nitrogen6x machine
MACHINEOVERRIDES:prepend:nitrogen6x = "updatehub-imx:"
WKS_FILES:updatehub-imx:nitrogen6x ??= "updatehub.imx.wks"
PREFERRED_PROVIDER_virtual/bootloader:updatehub-imx:nitrogen6x ??= "u-boot-boundary"
PREFERRED_RPROVIDER_u-boot-fw-utils:updatehub-imx:nitrogen6x ??= "u-boot-boundary-fw-utils"
WKS_FILE_DEPENDS:updatehub-imx:nitrogen6x ??= "u-boot-script-boundary-updatehub"



###
# Configuration for Toradex machines
#
# UpdateHub settings for apalis-imx6 machine
MACHINEOVERRIDES:prepend:apalis-imx6 = "updatehub-imx:"
WKS_FILES:updatehub-imx:apalis-imx6 ??= "updatehub.imx.wks"
UPDATEHUB_RUNTIME_PACKAGES:append:apalis-imx6 = " updatehub-config-toradex"
# UpdateHub Bootscript variables for apalis-imx6 machine
UPDATEHUB_BOOTSCRIPT_LOAD_A:updatehub-imx:apalis-imx6 ??= "\
load mmc \${devnum}:2 \${fdt_addr_r} /boot/\${fdtfile};\
load mmc \${devnum}:2 \${kernel_addr_r} /boot/${KERNEL_IMAGETYPE}; \
"
UPDATEHUB_BOOTSCRIPT_LOAD_B:updatehub-imx:apalis-imx6 ??= "\
load mmc \${devnum}:3 \${fdt_addr_r} /boot/\${fdtfile};\
load mmc \${devnum}:3 \${kernel_addr_r} /boot/${KERNEL_IMAGETYPE}; \
"
UPDATEHUB_BOOTSCRIPT_FIND_ROOT_A:updatehub-imx:apalis-imx6 ??= "part uuid mmc \${devnum}:2 uuid"
UPDATEHUB_BOOTSCRIPT_FIND_ROOT_B:updatehub-imx:apalis-imx6 ??= "part uuid mmc \${devnum}:3 uuid"
UPDATEHUB_BOOTSCRIPT_BOOTARGS:updatehub-imx:apalis-imx6 ??= "\
console=\${console},\${baudrate} root=PARTUUID=\${uuid} rw rootfstype=ext4 rootwait \${defargs} \${vidargs}\
"
UPDATEHUB_BOOTSCRIPT_BOOTCMD:updatehub-imx:apalis-imx6 ??= "bootz \${kernel_addr_r} - \${fdt_addr_r}"


# UpdateHub settings for colibri-imx6 machine
MACHINEOVERRIDES:prepend:colibri-imx6 = "updatehub-imx:"
WKS_FILES:updatehub-imx:colibri-imx6 ??= "updatehub.imx.wks"
UPDATEHUB_RUNTIME_PACKAGES:append:colibri-imx6 = " updatehub-config-toradex"
# UpdateHub Bootscript variables for colibri-imx6 machine
UPDATEHUB_BOOTSCRIPT_LOAD_A:updatehub-imx:colibri-imx6 ??= "\
load mmc \${devnum}:2 \${fdt_addr_r} /boot/\${fdtfile}; \
load mmc \${devnum}:2 \${kernel_addr_r} /boot/${KERNEL_IMAGETYPE} \
"
UPDATEHUB_BOOTSCRIPT_LOAD_B:updatehub-imx:colibri-imx6 ??= "\
load mmc \${devnum}:3 \${fdt_addr_r} /boot/\${fdtfile}; \
load mmc \${devnum}:3 \${kernel_addr_r} /boot/${KERNEL_IMAGETYPE} \
"
UPDATEHUB_BOOTSCRIPT_FIND_ROOT_A:updatehub-imx:colibri-imx6 ??= "part uuid mmc \${devnum}:2 uuid"
UPDATEHUB_BOOTSCRIPT_FIND_ROOT_B:updatehub-imx:colibri-imx6 ??= "part uuid mmc \${devnum}:3 uuid"
UPDATEHUB_BOOTSCRIPT_BOOTARGS:updatehub-imx:colibri-imx6 ??= "\
console=\${console},\${baudrate} root=PARTUUID=\${uuid} rw rootfstype=ext4 rootwait \${defargs} \${vidargs} \
"
UPDATEHUB_BOOTSCRIPT_BOOTCMD:updatehub-imx:colibri-imx6 ??= "bootz \${kernel_addr_r} - \${fdt_addr_r}"


# UpdateHub settings for colibri-imx7-emmc machine
MACHINEOVERRIDES:prepend:colibri-imx7-emmc = "updatehub-imx:"
WKS_FILES:updatehub-imx:colibri-imx7-emmc ??= "updatehub.imx.wks"
UPDATEHUB_RUNTIME_PACKAGES:append:colibri-imx7-emmc = " updatehub-config-toradex"
# UpdateHub Bootscript variables for colibri-imx7-emmc machine
UPDATEHUB_BOOTSCRIPT_LOAD_A:updatehub-imx:colibri-imx7-emmc ??= "\
load mmc \${devnum}:2 \${fdt_addr_r} /boot/\${fdtfile}; \
load mmc \${devnum}:2 \${kernel_addr_r} /boot/${KERNEL_IMAGETYPE} \
"
UPDATEHUB_BOOTSCRIPT_LOAD_B:updatehub-imx:colibri-imx7-emmc ??= "\
load mmc \${devnum}:3 \${fdt_addr_r} /boot/\${fdtfile}; \
load mmc \${devnum}:3 \${kernel_addr_r} /boot/${KERNEL_IMAGETYPE} \
"
UPDATEHUB_BOOTSCRIPT_FIND_ROOT_A:updatehub-imx:colibri-imx7-emmc ??= "part uuid mmc \${devnum}:2 uuid"
UPDATEHUB_BOOTSCRIPT_FIND_ROOT_B:updatehub-imx:colibri-imx7-emmc ??= "part uuid mmc \${devnum}:3 uuid"
UPDATEHUB_BOOTSCRIPT_BOOTARGS:updatehub-imx:colibri-imx7-emmc ??= "\
console=\${console},\${baudrate} root=PARTUUID=\${uuid} rw rootfstype=ext4 rootwait \${defargs} \${vidargs} \
"
UPDATEHUB_BOOTSCRIPT_BOOTCMD:updatehub-imx:colibri-imx7-emmc ??= "bootz \${kernel_addr_r} - \${fdt_addr_r}"



###
# Configuration for TechNexion/NXP devices
#
MACHINEOVERRIDES:prepend:imx7d-pico = "updatehub-imx:"
WKS_FILES:updatehub-imx:imx7d-pico ??= "updatehub.imx-uboot-spl-bootpart.wks.in"
IMAGE_BOOT_FILES:updatehub-imx:imx7d-pico ??= "boot.scr-${MACHINE};boot.scr"
# UpdateHub Bootscript variables for imx7d-pico machine
UPDATEHUB_BOOTSCRIPT_LOAD_A:updatehub-imx:imx7d-pico ??= "\
load mmc \${mmcdev}:2 \${loadaddr} /boot/\${image}; run findfdt; run video_args_script; \
load mmc \${mmcdev}:2 \${fdt_addr} /boot/\${fdtfile}; \
"
UPDATEHUB_BOOTSCRIPT_LOAD_B:updatehub-imx:imx7d-pico ??= "\
load mmc \${mmcdev}:3 \${loadaddr} /boot/\${image}; run findfdt; run video_args_script; \
load mmc \${mmcdev}:3 \${fdt_addr} /boot/\${fdtfile}; \
"
UPDATEHUB_BOOTSCRIPT_FIND_ROOT_A:updatehub-imx:imx7d-pico ??= "part uuid mmc \${mmcdev}:2 uuid"
UPDATEHUB_BOOTSCRIPT_FIND_ROOT_B:updatehub-imx:imx7d-pico ??= "part uuid mmc \${mmcdev}:3 uuid"
UPDATEHUB_BOOTSCRIPT_BOOTARGS:updatehub-imx:imx7d-pico ??= "\
root=PARTUUID=\${uuid} rootfstype=ext4 rootwait rw \
console=\${console},\${baudrate} \${video_args} \
"
UPDATEHUB_BOOTSCRIPT_BOOTCMD:updatehub-imx:imx7d-pico ??= "bootz \${loadaddr} - \${fdt_addr}"
```
